## board/main/Kconfig.projbuild
```kconfig
menu "Air-Quality Configuration"
    config WIFI_SSID
        string "WiFi SSID"
        default ""
    config WIFI_PASSWORD
        string "WiFi Password"
        default ""
	config MQTT_BROKER_URL
		string "MQTT Broker url"
		default ""
	config SLEEP_TIME
		string "Sleep time in minutes"
		default 5
	config HUM_PRECISION
		string "Humidity precision (decimal places)"
		default 2
		help 
			Number of digits after decimal point
	config TEMP_PRECISION 
		string "Temperature precision (decimal places)"
		default 2
		help 
			Number of digits after decimal point
endmenu
```
